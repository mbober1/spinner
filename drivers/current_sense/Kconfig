## drivers/current_sense/Kconfig
```kconfig
# Copyright (c) 2026
# SPDX-License-Identifier: Apache-2.0

menuconfig SPINNER_CURRENT_SENSE
	bool "Current sense adapter"
	depends on SPINNER_CURRSMP && SPINNER_SVPWM && FPU
	default y if $(dt_compat_enabled,$(DT_COMPAT_SPINNER_CURRENT_SENSE))
	select SPINNER_FILTER_LOW_PASS
	help
	  Enable the generic current sense adapter.

if SPINNER_CURRENT_SENSE

module = SPINNER_CURRENT_SENSE
module-str = SPINNER_CURRENT_SENSE
source "subsys/logging/Kconfig.template.log_config"

config SPINNER_CURRENT_SENSE_INIT_PRIORITY
	int "Current sense init priority"
	default 92
	help
	  Current sense initialization priority. Must be after currsmp and svpwm.

config SPINNER_CURRENT_SENSE_THREAD_PRIORITY
	int "Current sense thread priority"
	default -15
	help
	  Priority of the thread converting, filtering and regulating samples.

config SPINNER_CURRENT_SENSE_THREAD_STACK_SIZE
	int "Current sense thread stack size"
	default 512

endif # SPINNER_CURRENT_SENSE
```

## drivers/currsmp/Kconfig.stm32
```kconfig
# Copyright (c) 2021 Teslabs Engineering S.L.
# SPDX-License-Identifier: Apache-2.0

config SPINNER_CURRSMP_SHUNT_STM32
	bool "STM32 shunt current sampling driver"
	depends on SOC_FAMILY_STM32
	default y
	depends on DT_HAS_ST_STM32_CURRSMP_SHUNT_ENABLED
	select SPINNER_UTILS_STM32
	select USE_STM32_LL_ADC
	select ZERO_LATENCY_IRQS
	help
	  Enable shunt current sampling driver for STM32 SoCs

config SPINNER_CURRSMP_FILTER_LOW_PASS
	bool "Low-pass filter for phase currents"
	depends on SPINNER_CURRSMP_SHUNT_STM32 && SPINNER_SVPWM_STM32 && FPU
	select SPINNER_FILTER_LOW_PASS
	help
	  Filter phase current readings, sampled at the SV-PWM rate.
```

## drivers/feedback/Kconfig
```kconfig
# Copyright (c) 2021 Teslabs Engineering S.L.
# SPDX-License-Identifier: Apache-2.0

menuconfig SPINNER_FEEDBACK
	bool "Feedback Drivers"
	help
	  Enable options for feedback drivers.

if SPINNER_FEEDBACK

config SPINNER_FEEDBACK_RTIO
	bool "Asynchronous RTIO feedback"
	default y if SPINNER_FEEDBACK_MT6701
	depends on SENSOR_ASYNC_API
	select RTIO
	select FPU

config SPINNER_FEEDBACK_RTIO_SAMPLE_PERIOD_MS
	int "RTIO feedback filter sample period in milliseconds"
	default 10
	range 1 60000
	depends on SPINNER_FEEDBACK_RTIO
	help
	  Expected sample period used to initialize the optional feedback speed filter.

module = SPINNER_FEEDBACK
module-str = SPINNER_FEEDBACK
source "subsys/logging/Kconfig.template.log_config"

rsource "Kconfig.stm32"

endif # SPINNER_FEEDBACK
```

## dts/bindings/current_sense/spinner,current-sense.yaml
```yaml
# Copyright (c) 2026
# SPDX-License-Identifier: Apache-2.0

description: |
  Generic current sense adapter.

  Consumes raw samples from a current sampling device, converts them to
  phase currents and filters them.

compatible: "spinner,current-sense"

include: [base.yaml, filter.yaml]

properties:
  adc:
    type: phandle
    required: true
    description: Current sampling device providing raw samples.

  csa-gain-mv-per-a:
    type: int
    required: true
    description: |
      Current sense amplifier gain in mV/A.
```

## dts/bindings/feedback/spinner,mt6701-feedback.yaml
```yaml
# Copyright (c) 2026
# SPDX-License-Identifier: Apache-2.0

description: MT6701 sensor adapter for the Spinner feedback API.

compatible: "spinner,mt6701-feedback"

include: [base.yaml, filter.yaml]

properties:
  sensor:
    type: phandle
    required: true
    description: MT6701 sensor device providing rotation and RPM channels.
```

## dts/bindings/feedback/spinner,rtio-feedback.yaml
```yaml
# Copyright (c) 2026
# SPDX-License-Identifier: Apache-2.0

description: Generic asynchronous RTIO encoder adapter for Spinner feedback.

compatible: "spinner,rtio-feedback"

include: [base.yaml, filter.yaml]

properties:
  sensor:
    type: phandle
    required: true
    description: Async sensor device providing SENSOR_CHAN_ROTATION samples.
```

## dts/bindings/filter.yaml
```yaml
# Copyright (c) 2026
# SPDX-License-Identifier: Apache-2.0

properties:
  filter-cutoff-hz:
    type: int
    default: 10
    description: Low-pass filter cutoff frequency in Hz.
```

## dts/bindings/motor/spinner,motor.yaml
```yaml
# Copyright (c) 2026
# SPDX-License-Identifier: Apache-2.0

description: Motor configuration used by Spinner control loops.

compatible: "spinner,motor"

properties:
  pole-pairs:
    type: int
    required: true
    description: Motor pole-pair count.

  phase-offset-degrees:
    type: int
    default: 0
    description: Electrical phase offset in degrees.
```

## lib/Kconfig
```kconfig
# Copyright (c) 2021 Teslabs Engineering S.L.
# SPDX-License-Identifier: Apache-2.0

menu "Libraries"

rsource "control/Kconfig"
rsource "filter/Kconfig"
rsource "svm/Kconfig"
rsource "utils/Kconfig"

endmenu
```

## lib/filter/Kconfig
```kconfig
# Copyright (c) 2026
# SPDX-License-Identifier: Apache-2.0

menuconfig SPINNER_FILTER_LOW_PASS
	bool "Low-pass filter backend"
	help
	  Enable low-pass filtering.

if SPINNER_FILTER_LOW_PASS

choice SPINNER_FILTER_LOW_PASS_BACKEND
	prompt "Low-pass filter backend"
	default SPINNER_FILTER_LOW_PASS_BIQUAD

config SPINNER_FILTER_LOW_PASS_BIQUAD
	bool "CMSIS-DSP biquad"
	depends on FPU
	select CMSIS_DSP
	select CMSIS_DSP_FILTERING

endchoice

endif
```

## tests/lib/filter/low_pass_filter/testcase.yaml
```yaml
# Copyright (c) 2026
# SPDX-License-Identifier: Apache-2.0

tests:
  lib.low_pass_filter.biquad:
    tags: lib filter biquad
    extra_configs:
      - CONFIG_SPINNER_FILTER_LOW_PASS_BIQUAD=y
    integration_platforms:
      - native_sim
  lib.low_pass_filter.fir:
    tags: lib filter fir
    extra_configs:
      - CONFIG_SPINNER_FILTER_LOW_PASS_FIR=y
      - CONFIG_SPINNER_FILTER_LOW_PASS_MAX_TAPS=31
    integration_platforms:
      - native_sim
```
