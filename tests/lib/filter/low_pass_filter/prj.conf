## CMakeLists.txt
```
# Copyright (c) 2026
# SPDX-License-Identifier: Apache-2.0

cmake_minimum_required(VERSION 3.20.0)
find_package(Zephyr REQUIRED HINTS $ENV{ZEPHYR_BASE})

project(lib_low_pass_filter)
target_sources(app PRIVATE src/main.c)
```

## prj.conf
```kconfig
CONFIG_ZTEST=y
CONFIG_FPU=y
CONFIG_SPINNER_FILTER_LOW_PASS=y
```

## src/main.c
```c
/*
 * Copyright (c) 2026
 * SPDX-License-Identifier: Apache-2.0
 */

#include <errno.h>
#include <math.h>

#include <zephyr/ztest.h>

#include <spinner/filter/low_pass_filter.h>

static const struct low_pass_filter_config filter_config = {
	.cutoff_hz = 10.0f,
};

ZTEST(low_pass_filter, test_invalid_configuration)
{
	struct low_pass_filter filter;
	struct low_pass_filter_config invalid = filter_config;

	zassert_equal(low_pass_filter_init(NULL, 100U, &filter_config), -EINVAL, NULL);
	zassert_equal(low_pass_filter_init(&filter, 0U, &filter_config), -EINVAL, NULL);

	invalid.cutoff_hz = 50.0f;
	zassert_equal(low_pass_filter_init(&filter, 100U, &invalid), -EINVAL, NULL);
}

ZTEST(low_pass_filter, test_constant_input_converges)
{
	struct low_pass_filter filter;
	float output = 0.0f;

	zassert_equal(low_pass_filter_init(&filter, 100U, &filter_config), 0, NULL);
	for (size_t i = 0; i < 200U; i++) {
		output = low_pass_filter_process(&filter, 1.0f);
	}

	zassert_true(isfinite(output), NULL);
	zassert_true(fabsf(output - 1.0f) < 0.01f, NULL);
}

ZTEST(low_pass_filter, test_reinitialization_resets_state)
{
	struct low_pass_filter filter;
	float output;

	zassert_equal(low_pass_filter_init(&filter, 100U, &filter_config), 0, NULL);
	(void)low_pass_filter_process(&filter, 1.0f);
	zassert_equal(low_pass_filter_init(&filter, 100U, &filter_config), 0, NULL);
	output = low_pass_filter_process(&filter, 0.0f);

	zassert_true(fabsf(output) < 0.001f, NULL);
}

ZTEST_SUITE(low_pass_filter, NULL, NULL, NULL, NULL, NULL);
```
